## defconfig
```kconfig
# Default build configuration for modular-make demo.
# Generated by: make defconfig
# Edit to enable/disable features, then rebuild.
#
# Boolean options: 'y' to enable, 'n' (or comment out) to disable.
# Non-boolean CONFIG_ values are emitted verbatim into config.h.

# Custom greeting string for the C greeter
CONFIG_CUSTOM_GREETING = n
CONFIG_GREETING_STR = "Hello"
```

## tests/defconfig
```kconfig
# Test suite default configuration
CONFIG_EXTRA = y
CONFIG_EXTRA_LABEL = "bonus"
```
